## sources/meta-can-hat/conf/layer.conf
```bitbake
## @file layer.conf
#
# meta-can-hat layer configuration file.
#
# (C) Automotive Systems Consulting. 2024
# All rights reserved.

BBPATH =. "${LAYERDIR}:"

BBFILES += "${LAYERDIR}/recipes-*/*/*.bb \
            ${LAYERDIR}/recipes-*/*/*.bbappend"

BBFILE_COLLECTIONS += "meta-can-hat"

BBFILE_PATTERN_meta-can-hat = "^${LAYERDIR}/"

BBFILE_PRIORITY_meta-can-hat = "20"

LAYERSERIES_COMPAT_meta-can-hat = "kirkstone"

# Layer version.
LAYERVERSION:can-hat = "1"
```
